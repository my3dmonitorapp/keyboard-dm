## firmware/Kconfig.projbuild
```kconfig
menu "Keyboard DM firmware"

choice KBDM_FAMILY
    prompt "Firmware family"
    default KBDM_FAMILY_ESP32 if IDF_TARGET_ESP32
    default KBDM_FAMILY_ESP32C3 if IDF_TARGET_ESP32C3

config KBDM_FAMILY_ESP32
    bool "ESP32"
    depends on IDF_TARGET_ESP32

config KBDM_FAMILY_ESP32C3
    bool "ESP32-C3"
    depends on IDF_TARGET_ESP32C3
endchoice

config KBDM_BLE_ENABLED
    bool "Enable BLE HID"
    default y

config KBDM_NVS_CONFIG_VERSION
    int "NVS config record version"
    range 1 65535
    default 1

config KBDM_SERIAL_BAUD
    int "Serial protocol baud"
    range 9600 2000000
    default 115200
    help
        Applied to UART0 on classic ESP32. USB Serial/JTAG on ESP32-C3 is a
        USB transport and does not have a physical UART baud rate.

config KBDM_SCAN_PERIOD_MS
    int "Runtime scan period (milliseconds)"
    range 1 100
    default 1

config KBDM_RUNTIME_TASK_STACK
    int "Runtime task stack size (bytes)"
    range 12288 32768
    default 16384

config KBDM_RUNTIME_TASK_PRIORITY
    int "Runtime task priority"
    range 1 20
    default 5

endmenu
```

## firmware/targets/esp32c3/boards/unverified/Kconfig
```kconfig
menu "Unverified ESP32-C3 board"
config KBDM_BOARD_PINMAP_VERIFIED
    bool "Board pin map has passed the F1 hardware gate"
    default n
config KBDM_BOARD_ROW_COUNT
    int
    default 0
config KBDM_BOARD_COL_COUNT
    int
    default 0
endmenu
```

## firmware/targets/esp32c3/sdkconfig.defaults
```kconfig
CONFIG_IDF_TARGET="esp32c3"
CONFIG_ESP_CONSOLE_USB_SERIAL_JTAG=y
CONFIG_BT_BLE_42_FEATURES_SUPPORTED=y
# CONFIG_BT_BLE_50_FEATURES_SUPPORTED is not set
```
